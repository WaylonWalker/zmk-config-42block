#include "../42block/42block.overlay"
#include <dt-bindings/zmk/matrix_transform.h>
#include "ironhorse_view_transform.dtsi"

/ {
    chosen {
        zmk,matrix-transform = &ironhorse_transform;
    };

    ironhorse_transform: matrix_transform {
        compatible = "zmk,matrix-transform";
        rows = <4>;
        columns = <21>;
        map = <IRONHORSE_VIEW_TRANSFORM_MAP>;
    };
};
