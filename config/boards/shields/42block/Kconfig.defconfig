## config/boards/shields/42block/Kconfig.defconfig
```kconfig
if SHIELD_42BLOCK

config ZMK_KEYBOARD_NAME
    default "42ShortBlock"

config USB_DEVICE_MANUFACTURER
    default "Waylon Walker"

config ZMK_MOUSE
    default y

endif
```

## config/boards/shields/ironhorse/Kconfig.defconfig
```kconfig
if SHIELD_IRONHORSE

config ZMK_KEYBOARD_NAME
    default "ironhorse"

config USB_DEVICE_MANUFACTURER
    default "Waylon Walker"

config ZMK_MOUSE
    default y

config ZMK_SPLIT
    default y

config ZMK_SPLIT_ROLE_CENTRAL
    default y

endif
```

## config/boards/shields/ironhorse_view/Kconfig.defconfig
```kconfig
if SHIELD_IRONHORSE_VIEW

config ZMK_KEYBOARD_NAME
    default "ironhorse-view"

config USB_DEVICE_MANUFACTURER
    default "Waylon Walker"

config ZMK_SPLIT
    default y

endif
```

## config/boards/shields/ironhorse_view/Kconfig.shield
```kconfig
config SHIELD_IRONHORSE_VIEW
    def_bool $(shields_list_contains,ironhorse_view)
```

## config/boards/shields/macropad/Kconfig.defconfig
```kconfig
if SHIELD_42BLOCK

config ZMK_KEYBOARD_NAME
    default "portajohnlp"

config USB_DEVICE_MANUFACTURER
    default "Waylon Walker"

config ZMK_MOUSE
    default y

endif
```

## config/boards/shields/portajohn/Kconfig.defconfig
```kconfig
if SHIELD_PORTAJOHN

config ZMK_KEYBOARD_NAME
    default "portajohn"

config USB_DEVICE_MANUFACTURER
    default "Waylon Walker"

config ZMK_MOUSE
    default y

endif
```

## config/west.yml
```yaml
manifest:
  remotes:
    - name: zmkfirmware
      url-base: https://github.com/zmkfirmware
      # Additional modules containing boards/shields/custom code can be listed here as well
      # See https://docs.zephyrproject.org/3.2.0/develop/west/manifest.html#projects
  projects:
    - name: zmk
      remote: zmkfirmware
      revision: 904c9aec8822d79149d42c8a9a77e8828eb08f5a
      import: app/west.yml
  self:
    path: config
```
